## prj.conf
```kconfig
CONFIG_MYFUNCTION=y #enable the config
```

## nrf52dk_nrf52832.overlay
```dts
/*  the file name must be the same name as the target board, and
 the file must end with .overlay : <board_name>.overlay */
```

## src/main.c
```c
#include <zephyr/kernel.h>
#include <zephyr/sys/printk.h>
#ifdef CONFIG_MYFUNCTION
#include "myfunction.h"
#endif

int main(void)
{
	int a = 9, b = 9;
	while (1)
	{
		printk("The sum of %d and %d is %d\n\r", a, b, sum(a, b));
		k_msleep(1000);
	}
}
```

## src/myfunction.c
```c
#include "myfunction.h"

int sum(int a, int b)
{
return a+b;
}
```
